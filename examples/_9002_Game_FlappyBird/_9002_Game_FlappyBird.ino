// Flappy Bird Simulator for ESPresso Lite

#include <ESPert.h>
ESPert espert;

// button pin
#ifdef ARDUINO_ESP8266_ESPRESSO_LITE_V1
int buttonPin[2] = {0, 2};
#else
int buttonPin[2] = {0, 13};
#endif
int gamepadPin[2] = {14, 1};
bool isGamepadEnabled = false;

// sound (buzzer)
static const int buzzerPin = 12;
float buzzerDuration = 0.0f;
bool isSoundEnabled = true;

// OLED bitmaps - Image to Adafruit OLED Bitmap Converter http://www.majer.ch/lcd/adf_bitmap.php
static const int numberOfFrames = 3;
static const int numberOfDegrees = 5;
const uint8_t backgroundBitmap[128 * 64 / 8] PROGMEM = {0x00};

const uint8_t makerAsiaBitmap[] PROGMEM = { // makerAsia.png
  0xFF, 0x87, 0x03, 0x4B, 0x31, 0x31, 0x4B, 0x03, 0x87, 0xFF,
  0xFF, 0x07, 0xF7, 0x8F, 0xF7, 0x07, 0xFF, 0x07, 0xD7, 0x07,
  0xFF, 0x07, 0xDF, 0x27, 0xFF, 0x07, 0x57, 0x57, 0xFF, 0x07,
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  0xFF, 0xFF, 0xFF, 0xFF, 0xFF, 0xFF, 0xFF, 0xFF
};

const uint8_t makerAsiaMaskBitmap[] PROGMEM = { // makerAsiaMask.png
  0x87, 0x03, 0x01, 0x01, 0x00, 0x00, 0x01, 0x01, 0x03, 0x87,
  0x07, 0x03, 0x03, 0x03, 0x03, 0x03, 0x07, 0x03, 0x03, 0x03,
  0x07, 0x03, 0x07, 0x03, 0x07, 0x03, 0x03, 0x03, 0x03, 0x03,
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  0xFF, 0xFF, 0xFF, 0xFF, 0xFF, 0xFF, 0xFF, 0xFF
};

const uint8_t gameOverBitmap[] PROGMEM = { // gameOver.png
  0x07, 0xFB, 0x0D, 0x05, 0xE5, 0x25, 0x25, 0xFD, 0x61, 0x37,
  0x17, 0x17, 0x17, 0x17, 0xF7, 0x17, 0x17, 0x17, 0x17, 0x17,
  0x17, 0x17, 0x17, 0x37, 0x67, 0xF7, 0x1B, 0x0B, 0xCB, 0x0B,
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  0xBF, 0xA0, 0xA0, 0xA0, 0xBF, 0x81, 0xFD, 0xFC
};

const uint8_t gameOverMaskBitmap[] PROGMEM = { // gameOverMask.png
  0x07, 0x03, 0x01, 0x01, 0x01, 0x01, 0x01, 0x01, 0x01, 0x07,
  0x07, 0x07, 0x07, 0x07, 0x07, 0x07, 0x07, 0x07, 0x07, 0x07,
  0x07, 0x07, 0x07, 0x07, 0x07, 0x07, 0x03, 0x03, 0x03, 0x03,
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  0x80, 0x80, 0x80, 0x80, 0x80, 0x80, 0xFC, 0xFC
};

const uint8_t scorePanelBitmap[] PROGMEM = { // scorePanel.png
  0x07, 0xFB, 0xFD, 0xFE, 0xFE, 0xFE, 0xFE, 0xFE, 0x82, 0xF6,
  0xEE, 0xF6, 0x82, 0xFE, 0x82, 0xAA, 0xAA, 0xFE, 0x82, 0xBA,
  0xBA, 0xC6, 0xFE, 0x86, 0xDA, 0xDA, 0x86, 0xFE, 0x82, 0xBE,
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  0xCF, 0xCF, 0xCF, 0xCF, 0xE7, 0xF3, 0xF8, 0xFF, 0xFF, 0xFF
};

const uint8_t scorePanelMaskBitmap[] PROGMEM = { // scorePanelMask.png
  0x07, 0x03, 0x01, 0x00, 0x00, 0x00, 0x00, 0x00, 0x00, 0x00,
  0x00, 0x00, 0x00, 0x00, 0x00, 0x00, 0x00, 0x00, 0x00, 0x00,
  0x00, 0x00, 0x00, 0x00, 0x00, 0x00, 0x00, 0x00, 0x00, 0x00,
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  0xC0, 0xC0, 0xC0, 0xC0, 0xE0, 0xF0, 0xF8, 0xFF, 0xFF, 0xFF
};

const uint8_t titleBitmap[] PROGMEM = { // title.png
  0x03, 0xFD, 0xFE, 0xFE, 0x76, 0x76, 0x00, 0xFE, 0xFE, 0xFE,
  0x00, 0xEF, 0xF7, 0xF7, 0x37, 0xF7, 0xF7, 0x07, 0xF7, 0xF7,
  0xF7, 0x37, 0xF7, 0xEF, 0x07, 0xF7, 0xF7, 0xF7, 0x37, 0xF7,
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  0xF8, 0xF3, 0xE7, 0xE7, 0xE6, 0xE7, 0xE7, 0xE0
};

const uint8_t titleMaskBitmap[] PROGMEM = { // titleMask.png
  0x03, 0x01, 0x00, 0x00, 0x00, 0x00, 0x00, 0x00, 0x00, 0x00,
  0x00, 0x0F, 0x07, 0x07, 0x07, 0x07, 0x07, 0x07, 0x07, 0x07,
  0x07, 0x07, 0x07, 0x0F, 0x07, 0x07, 0x07, 0x07, 0x07, 0x07,
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  0xF8, 0xF0, 0xE0, 0xE0, 0xE0, 0xE0, 0xE0, 0xE0
};

const uint8_t getReadyBitmap[] PROGMEM = { // getReady.png
  0x03, 0xFD, 0x06, 0x02, 0xF2, 0x12, 0x12, 0x12, 0xFE, 0x08,
  0x05, 0x65, 0x05, 0x0D, 0xFB, 0x90, 0x9E, 0x02, 0x02, 0x9E,
  0x90, 0xF7, 0x07, 0xFF, 0xFF, 0x00, 0xFE, 0x02, 0x02, 0x72,
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  0xFF, 0xFF, 0xFF, 0xFF, 0xFF, 0xFF, 0xFF, 0xFF
};

const uint8_t getReadyMaskBitmap[] PROGMEM = { // getReadyMask.png
  0x03, 0x01, 0x00, 0x00, 0x00, 0x00, 0x00, 0x00, 0x00, 0x00,
  0x01, 0x01, 0x01, 0x01, 0x03, 0x00, 0x00, 0x00, 0x00, 0x00,
  0x00, 0x07, 0x07, 0xFF, 0xFF, 0x00, 0x00, 0x00, 0x00, 0x00,
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  0xFF, 0xFF, 0xFF, 0xFF, 0xFF, 0xFF, 0xFF, 0xFF
};

const uint8_t birdBitmap[numberOfFrames][numberOfDegrees][32] PROGMEM = {
  {
    {0xFF, 0xFF, 0x1F, 0x4F, 0xB7, 0xBB, 0xBB, 0x63, 0xDD, 0xBD, 0x3D, 0xAD, 0x9B, 0x47, 0xAF, 0x4F, 0xF3, 0xEC, 0xEF, 0xEF, 0xEF, 0xCF, 0xB7, 0xB8, 0xBF, 0xDF, 0xDE, 0xED, 0xF2, 0xFB, 0xFD, 0xFE}, // bird00.png
    {0x3F, 0xDF, 0xDF, 0xCF, 0xD7, 0xB7, 0x7B, 0xFB, 0x8B, 0x73, 0xFB, 0xFB, 0x97, 0xEF, 0x1F, 0xFF, 0xFE, 0xFD, 0xF3, 0xEB, 0xEB, 0xDD, 0xDE, 0xDF, 0xDB, 0xD5, 0xEA, 0xEA, 0xEA, 0xEA, 0xF2, 0xF8}, // bird01.png
    {0xFF, 0x07, 0x7B, 0xFB, 0xFB, 0xFB, 0xE3, 0x1B, 0xFB, 0x3B, 0xD7, 0xEF, 0xEF, 0xDF, 0x3F, 0xFF, 0xFF, 0xFC, 0xFB, 0xF6, 0xEE, 0xDE, 0xDE, 0xC7, 0xD9, 0xB6, 0xAD, 0x9B, 0xB6, 0xC7, 0xF8, 0xFF}, // bird02.png
    {0xFF, 0x3F, 0xDF, 0xC1, 0xBE, 0x7E, 0x7D, 0x7D, 0x73, 0x8B, 0xF3, 0x77, 0x6F, 0x1F, 0xFF, 0xFF, 0xFF, 0xFE, 0xF9, 0xF7, 0xEF, 0xCF, 0xB7, 0x6B, 0x5B, 0xA1, 0x4E, 0x17, 0xDF, 0xEF, 0xF0, 0xFF}, // bird03.png
    {0xFF, 0xFF, 0x1F, 0xE7, 0xFB, 0xE3, 0xDD, 0xBE, 0xBE, 0xDE, 0xE1, 0xF7, 0xCF, 0x3F, 0xFF, 0xFF, 0xFF, 0xFF, 0xFC, 0xC3, 0xBD, 0x02, 0x7D, 0x03, 0xBD, 0xAE, 0xAE, 0xDE, 0xED, 0xF0, 0xFF, 0xFF}  // bird04.png
  },
  {
    {0xFF, 0x7F, 0x9F, 0xEF, 0x77, 0xBB, 0xBB, 0x23, 0xDD, 0xBD, 0x3D, 0xAD, 0x9B, 0x47, 0xAF, 0x4F, 0xFF, 0xF0, 0xED, 0xDE, 0xDF, 0xCF, 0xB3, 0xBC, 0xBF, 0xDF, 0xDE, 0xED, 0xF2, 0xFB, 0xFD, 0xFE}, // bird10.png
    {0xFF, 0x3F, 0x5F, 0x6F, 0x77, 0x77, 0xFB, 0xFB, 0x8B, 0x73, 0xFB, 0xFB, 0x97, 0xEF, 0x1F, 0xFF, 0xFC, 0xFB, 0xF3, 0xEB, 0xEB, 0xDB, 0xDC, 0xDF, 0xDB, 0xD5, 0xEA, 0xEA, 0xEA, 0xEA, 0xF2, 0xF8}, // bird11.png
    {0xFF, 0x07, 0xBB, 0x7B, 0xF7, 0xEB, 0xDB, 0x3B, 0xFB, 0x3B, 0xD7, 0xEF, 0xEF, 0xDF, 0x3F, 0xFF, 0xFF, 0xFC, 0xFB, 0xF7, 0xEE, 0xDE, 0xDE, 0xC7, 0xD9, 0xB6, 0xAD, 0x9B, 0xB6, 0xC7, 0xF8, 0xFF}, // bird12.png
    {0xFF, 0x3F, 0xC7, 0xDB, 0xBD, 0xBD, 0x79, 0x75, 0x6D, 0x1B, 0xFB, 0x77, 0x6F, 0x1F, 0xFF, 0xFF, 0xFF, 0xFE, 0xF9, 0xF7, 0xEF, 0xCF, 0xB7, 0x6B, 0x5B, 0xA1, 0x4E, 0x17, 0xDF, 0xEF, 0xF0, 0xFF}, // bird13.png
    {0xFF, 0xFF, 0x1F, 0xE7, 0xFB, 0xC1, 0xBE, 0xBE, 0xC1, 0xFD, 0xFB, 0xF7, 0xCF, 0x3F, 0xFF, 0xFF, 0xFF, 0xFF, 0xFC, 0xC3, 0xBD, 0x02, 0x7D, 0x03, 0xBD, 0xAE, 0xAE, 0xDE, 0xED, 0xF0, 0xFF, 0xFF}  // bird14.png
  },
  {
    {0xFF, 0x7F, 0x9F, 0xEF, 0xF7, 0x7B, 0xBB, 0x23, 0xDD, 0xBD, 0x3D, 0xAD, 0x9B, 0x47, 0xAF, 0x4F, 0xFF, 0xF0, 0xEB, 0xDD, 0xDE, 0xDF, 0xAF, 0xAF, 0xB0, 0xDF, 0xDE, 0xED, 0xF2, 0xFB, 0xFD, 0xFE}, // bird20.png
    {0xFF, 0x3F, 0xDF, 0xEF, 0xF7, 0xF7, 0xFB, 0xFB, 0x8B, 0x73, 0xFB, 0xFB, 0x97, 0xEF, 0x1F, 0xFF, 0xF1, 0xEE, 0xEE, 0xEE, 0xE6, 0xDA, 0xDD, 0xDF, 0xDB, 0xD5, 0xEA, 0xEA, 0xEA, 0xEA, 0xF2, 0xF8}, // bird21.png
    {0xFF, 0x1F, 0xEF, 0xF7, 0xE7, 0xDB, 0xBB, 0x7B, 0xFB, 0x3B, 0xD7, 0xEF, 0xEF, 0xDF, 0x3F, 0xFF, 0xFF, 0xFC, 0xFB, 0xF3, 0xEB, 0xDB, 0xDD, 0xC6, 0xD9, 0xB6, 0xAD, 0x9B, 0xB6, 0xC7, 0xF8, 0xFF}, // bird22.png
    {0xFF, 0x3F, 0xC7, 0x3B, 0xFD, 0xF9, 0xF5, 0xED, 0x5D, 0x3B, 0xFB, 0x77, 0x6F, 0x1F, 0xFF, 0xFF, 0xFF, 0xFE, 0xF9, 0xF7, 0xEE, 0xCE, 0xB6, 0x6A, 0x5B, 0xA1, 0x4E, 0x17, 0xDF, 0xEF, 0xF0, 0xFF}, // bird23.png
    {0xFF, 0xFF, 0x1F, 0xE1, 0xEE, 0xDE, 0xBE, 0xC1, 0xFD, 0xFD, 0xFB, 0xF7, 0xCF, 0x3F, 0xFF, 0xFF, 0xFF, 0xFF, 0xFC, 0xC3, 0xBD, 0x02, 0x7D, 0x03, 0xBD, 0xAE, 0xAE, 0xDE, 0xED, 0xF0, 0xFF, 0xFF}  // bird24.png
  }
};

const uint8_t birdMaskBitmap[numberOfFrames][numberOfDegrees][32] PROGMEM = {
  {
    {0xFF, 0xFF, 0x1F, 0x0F, 0x07, 0x03, 0x03, 0x03, 0x01, 0x01, 0x01, 0x01, 0x03, 0x07, 0x0F, 0x0F, 0xF3, 0xE0, 0xE0, 0xE0, 0xE0, 0xC0, 0x80, 0x80, 0x80, 0xC0, 0xC0, 0xE0, 0xF0, 0xF8, 0xFC, 0xFE}, // birdMask00.png
    {0x3F, 0x1F, 0x1F, 0x0F, 0x07, 0x07, 0x03, 0x03, 0x03, 0x03, 0x03, 0x03, 0x07, 0x0F, 0x1F, 0xFF, 0xFE, 0xFC, 0xF0, 0xE0, 0xE0, 0xC0, 0xC0, 0xC0, 0xC0, 0xC0, 0xE0, 0xE0, 0xE0, 0xE0, 0xF0, 0xF8}, // birdMask01.png
    {0xFF, 0x07, 0x03, 0x03, 0x03, 0x03, 0x03, 0x03, 0x03, 0x03, 0x07, 0x0F, 0x0F, 0x1F, 0x3F, 0xFF, 0xFF, 0xFC, 0xF8, 0xF0, 0xE0, 0xC0, 0xC0, 0xC0, 0xC0, 0x80, 0x80, 0x80, 0x80, 0xC0, 0xF8, 0xFF}, // birdMask02.png
    {0xFF, 0x3F, 0x1F, 0x01, 0x00, 0x00, 0x01, 0x01, 0x03, 0x03, 0x03, 0x07, 0x0F, 0x1F, 0xFF, 0xFF, 0xFF, 0xFE, 0xF8, 0xF0, 0xE0, 0xC0, 0x80, 0x00, 0x00, 0x00, 0x00, 0x00, 0xC0, 0xE0, 0xF0, 0xFF}, // birdMask03.png
    {0xFF, 0xFF, 0x1F, 0x07, 0x03, 0x03, 0x01, 0x00, 0x00, 0x00, 0x01, 0x07, 0x0F, 0x3F, 0xFF, 0xFF, 0xFF, 0xFF, 0xFC, 0xC0, 0x80, 0x00, 0x00, 0x00, 0x80, 0x80, 0x80, 0xC0, 0xE0, 0xF0, 0xFF, 0xFF}  // birdMask04.png
  },
  {
    {0xFF, 0x7F, 0x1F, 0x0F, 0x07, 0x03, 0x03, 0x03, 0x01, 0x01, 0x01, 0x01, 0x03, 0x07, 0x0F, 0x0F, 0xFF, 0xF0, 0xE0, 0xC0, 0xC0, 0xC0, 0x80, 0x80, 0x80, 0xC0, 0xC0, 0xE0, 0xF0, 0xF8, 0xFC, 0xFE}, // birdMask10.png
    {0xFF, 0x3F, 0x1F, 0x0F, 0x07, 0x07, 0x03, 0x03, 0x03, 0x03, 0x03, 0x03, 0x07, 0x0F, 0x1F, 0xFF, 0xFC, 0xF8, 0xF0, 0xE0, 0xE0, 0xC0, 0xC0, 0xC0, 0xC0, 0xC0, 0xE0, 0xE0, 0xE0, 0xE0, 0xF0, 0xF8}, // birdMask11.png
    {0xFF, 0x07, 0x03, 0x03, 0x07, 0x03, 0x03, 0x03, 0x03, 0x03, 0x07, 0x0F, 0x0F, 0x1F, 0x3F, 0xFF, 0xFF, 0xFC, 0xF8, 0xF0, 0xE0, 0xC0, 0xC0, 0xC0, 0xC0, 0x80, 0x80, 0x80, 0x80, 0xC0, 0xF8, 0xFF}, // birdMask12.png
    {0xFF, 0x3F, 0x07, 0x03, 0x01, 0x01, 0x01, 0x01, 0x01, 0x03, 0x03, 0x07, 0x0F, 0x1F, 0xFF, 0xFF, 0xFF, 0xFE, 0xF8, 0xF0, 0xE0, 0xC0, 0x80, 0x00, 0x00, 0x00, 0x00, 0x00, 0xC0, 0xE0, 0xF0, 0xFF}, // birdMask13.png
    {0xFF, 0xFF, 0x1F, 0x07, 0x03, 0x01, 0x00, 0x00, 0x01, 0x01, 0x03, 0x07, 0x0F, 0x3F, 0xFF, 0xFF, 0xFF, 0xFF, 0xFC, 0xC0, 0x80, 0x00, 0x00, 0x00, 0x80, 0x80, 0x80, 0xC0, 0xE0, 0xF0, 0xFF, 0xFF}  // birdMask14.png
  },
  {
    {0xFF, 0x7F, 0x1F, 0x0F, 0x07, 0x03, 0x03, 0x03, 0x01, 0x01, 0x01, 0x01, 0x03, 0x07, 0x0F, 0x0F, 0xFF, 0xF0, 0xE0, 0xC0, 0xC0, 0xC0, 0x80, 0x80, 0x80, 0xC0, 0xC0, 0xE0, 0xF0, 0xF8, 0xFC, 0xFE}, // birdMask20.png
    {0xFF, 0x3F, 0x1F, 0x0F, 0x07, 0x07, 0x03, 0x03, 0x03, 0x03, 0x03, 0x03, 0x07, 0x0F, 0x1F, 0xFF, 0xF1, 0xE0, 0xE0, 0xE0, 0xE0, 0xC0, 0xC0, 0xC0, 0xC0, 0xC0, 0xE0, 0xE0, 0xE0, 0xE0, 0xF0, 0xF8}, // birdMask21.png
    {0xFF, 0x1F, 0x0F, 0x07, 0x07, 0x03, 0x03, 0x03, 0x03, 0x03, 0x07, 0x0F, 0x0F, 0x1F, 0x3F, 0xFF, 0xFF, 0xFC, 0xF8, 0xF0, 0xE0, 0xC0, 0xC0, 0xC0, 0xC0, 0x80, 0x80, 0x80, 0x80, 0xC0, 0xF8, 0xFF}, // birdMask22.png
    {0xFF, 0x3F, 0x07, 0x03, 0x01, 0x01, 0x01, 0x01, 0x01, 0x03, 0x03, 0x07, 0x0F, 0x1F, 0xFF, 0xFF, 0xFF, 0xFE, 0xF8, 0xF0, 0xE0, 0xC0, 0x80, 0x00, 0x00, 0x00, 0x00, 0x00, 0xC0, 0xE0, 0xF0, 0xFF}, // birdMask23.png
    {0xFF, 0xFF, 0x1F, 0x01, 0x00, 0x00, 0x00, 0x01, 0x01, 0x01, 0x03, 0x07, 0x0F, 0x3F, 0xFF, 0xFF, 0xFF, 0xFF, 0xFC, 0xC0, 0x80, 0x00, 0x00, 0x00, 0x80, 0x80, 0x80, 0xC0, 0xE0, 0xF0, 0xFF, 0xFF}  // birdMask24.png
  }
};

const uint8_t numberBitmap[10][8] PROGMEM {
  {0x80, 0xBE, 0xA2, 0xA2, 0xBE, 0x80, 0xFF, 0xFF}, // number0.png
  {0xFF, 0xFF, 0xFF, 0x80, 0xBE, 0x80, 0xFF, 0xFF}, // number1.png
  {0x80, 0xBA, 0xAA, 0xAA, 0xAE, 0x80, 0xFF, 0xFF}, // number2.png
  {0x80, 0xAA, 0xAA, 0xAA, 0xBE, 0x80, 0xFF, 0xFF}, // number3.png
  {0xE0, 0xEE, 0xE8, 0x88, 0xBE, 0x80, 0xFF, 0xFF}, // number4.png
  {0x80, 0xAE, 0xAA, 0xAA, 0xBA, 0x80, 0xFF, 0xFF}, // number5.png
  {0x80, 0xBE, 0xAA, 0xAA, 0xBA, 0x80, 0xFF, 0xFF}, // number6.png
  {0xF8, 0xFA, 0xFA, 0x82, 0xBE, 0x80, 0xFF, 0xFF}, // number7.png
  {0x80, 0xBE, 0xAA, 0xAA, 0xBE, 0x80, 0xFF, 0xFF}, // number8.png
  {0x80, 0xAE, 0xAA, 0xAA, 0xBE, 0x80, 0xFF, 0xFF}  // number9.png
};

const uint8_t numberMaskBitmap[10][8] PROGMEM {
  {0x80, 0x80, 0x80, 0x80, 0x80, 0x80, 0xFF, 0xFF}, // numberMask0.png
  {0xFF, 0xFF, 0xFF, 0x80, 0x80, 0x80, 0xFF, 0xFF}, // numberMask1.png
  {0x80, 0x80, 0x80, 0x80, 0x80, 0x80, 0xFF, 0xFF}, // numberMask2.png
  {0x80, 0x80, 0x80, 0x80, 0x80, 0x80, 0xFF, 0xFF}, // numberMask3.png
  {0xE0, 0xE0, 0xE0, 0x80, 0x80, 0x80, 0xFF, 0xFF}, // numberMask4.png
  {0x80, 0x80, 0x80, 0x80, 0x80, 0x80, 0xFF, 0xFF}, // numberMask5.png
  {0x80, 0x80, 0x80, 0x80, 0x80, 0x80, 0xFF, 0xFF}, // numberMask6.png
  {0xF8, 0xF8, 0xF8, 0x80, 0x80, 0x80, 0xFF, 0xFF}, // numberMask7.png
  {0x80, 0x80, 0x80, 0x80, 0x80, 0x80, 0xFF, 0xFF}, // numberMask8.png
  {0x80, 0x80, 0x80, 0x80, 0x80, 0x80, 0xFF, 0xFF}  // numberMask9.png
};

const uint8_t numberScoreBitmap[10][16] PROGMEM {
  {0x00, 0xFE, 0xFE, 0x86, 0xFE, 0xFE, 0x00, 0x01, 0xFC, 0xF9, 0xF9, 0xF9, 0xF9, 0xF9, 0xF8, 0xF8}, // numberScore0.png
  {0xFF, 0xFF, 0xF0, 0x06, 0xFE, 0xFE, 0x00, 0x01, 0xFF, 0xFF, 0xFF, 0xFC, 0xF9, 0xF9, 0xF8, 0xF8}, // numberScore1.png
  {0x00, 0xF6, 0xF6, 0xB6, 0xBE, 0xBE, 0x00, 0x01, 0xFC, 0xF9, 0xF9, 0xF9, 0xF9, 0xF9, 0xF8, 0xF8}, // numberScore2.png
  {0x00, 0xB6, 0xB6, 0xB6, 0xFE, 0xFE, 0x00, 0x01, 0xFC, 0xF9, 0xF9, 0xF9, 0xF9, 0xF9, 0xF8, 0xF8}, // numberScore3.png
  {0x00, 0x7E, 0x7E, 0x60, 0xFE, 0xFE, 0x00, 0x01, 0xFF, 0xFE, 0xFE, 0xFC, 0xF9, 0xF9, 0xF8, 0xF8}, // numberScore4.png
  {0x00, 0xBE, 0xBE, 0xB6, 0xF6, 0xF6, 0x00, 0x01, 0xFC, 0xF9, 0xF9, 0xF9, 0xF9, 0xF9, 0xF8, 0xF8}, // numberScore5.png
  {0x00, 0xFE, 0xFE, 0xB6, 0xF6, 0xF6, 0x00, 0x01, 0xFC, 0xF9, 0xF9, 0xF9, 0xF9, 0xF9, 0xF8, 0xF8}, // numberScore6.png
  {0xC0, 0x9E, 0x9E, 0x06, 0xFE, 0xFE, 0x00, 0x01, 0xFF, 0xFF, 0xFF, 0xFC, 0xF9, 0xF9, 0xF8, 0xF8}, // numberScore7.png
  {0x00, 0xFE, 0xFE, 0xB6, 0xFE, 0xFE, 0x00, 0x01, 0xFC, 0xF9, 0xF9, 0xF9, 0xF9, 0xF9, 0xF8, 0xF8}, // numberScore8.png
  {0x00, 0xBE, 0xBE, 0xB6, 0xFE, 0xFE, 0x00, 0x01, 0xFC, 0xF9, 0xF9, 0xF9, 0xF9, 0xF9, 0xF8, 0xF8}  // numberScore9.png
};

const uint8_t numberScoreMaskBitmap[10][16] PROGMEM {
  {0x00, 0x00, 0x00, 0x00, 0x00, 0x00, 0x00, 0x01, 0xFC, 0xF8, 0xF8, 0xF8, 0xF8, 0xF8, 0xF8, 0xF8}, // numberScoreMask0.png
  {0xFF, 0xFF, 0xF0, 0x00, 0x00, 0x00, 0x00, 0x01, 0xFF, 0xFF, 0xFF, 0xFC, 0xF8, 0xF8, 0xF8, 0xF8}, // numberScoreMask1.png
  {0x00, 0x00, 0x00, 0x00, 0x00, 0x00, 0x00, 0x01, 0xFC, 0xF8, 0xF8, 0xF8, 0xF8, 0xF8, 0xF8, 0xF8}, // numberScoreMask2.png
  {0x00, 0x00, 0x00, 0x00, 0x00, 0x00, 0x00, 0x01, 0xFC, 0xF8, 0xF8, 0xF8, 0xF8, 0xF8, 0xF8, 0xF8}, // numberScoreMask3.png
  {0x00, 0x00, 0x00, 0x00, 0x00, 0x00, 0x00, 0x01, 0xFF, 0xFE, 0xFE, 0xFC, 0xF8, 0xF8, 0xF8, 0xF8}, // numberScoreMask4.png
  {0x00, 0x00, 0x00, 0x00, 0x00, 0x00, 0x00, 0x01, 0xFC, 0xF8, 0xF8, 0xF8, 0xF8, 0xF8, 0xF8, 0xF8}, // numberScoreMask5.png
  {0x00, 0x00, 0x00, 0x00, 0x00, 0x00, 0x00, 0x01, 0xFC, 0xF8, 0xF8, 0xF8, 0xF8, 0xF8, 0xF8, 0xF8}, // numberScoreMask6.png
  {0xC0, 0x80, 0x80, 0x00, 0x00, 0x00, 0x00, 0x01, 0xFF, 0xFF, 0xFF, 0xFC, 0xF8, 0xF8, 0xF8, 0xF8}, // numberScoreMask7.png
  {0x00, 0x00, 0x00, 0x00, 0x00, 0x00, 0x00, 0x01, 0xFC, 0xF8, 0xF8, 0xF8, 0xF8, 0xF8, 0xF8, 0xF8}, // numberScoreMask8.png
  {0x00, 0x00, 0x00, 0x00, 0x00, 0x00, 0x00, 0x01, 0xFC, 0xF8, 0xF8, 0xF8, 0xF8, 0xF8, 0xF8, 0xF8}  // numberScoreMask9.png
};

const uint8_t landBitmap[] PROGMEM { // land.png
  0xFE, 0xFE, 0xF6, 0xF2, 0xF0, 0xF0, 0xF8, 0xFC, 0xFE, 0xFE,
  0xF6, 0xF2, 0xF0, 0xF0, 0xF8, 0xFC, 0xFE, 0xFE, 0xF6, 0xF2,
  0xF0, 0xF0, 0xF8, 0xFC, 0xFE, 0xFE, 0xF6, 0xF2, 0xF0, 0xF0,
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  0xFE, 0xFE, 0xF6, 0xF2, 0xF0, 0xF0, 0xF8, 0xFC
};

const uint8_t landMaskBitmap[] PROGMEM { // landMask.png
  0xF0, 0xF0, 0xF0, 0xF0, 0xF0, 0xF0, 0xF0, 0xF0, 0xF0, 0xF0,
  0xF0, 0xF0, 0xF0, 0xF0, 0xF0, 0xF0, 0xF0, 0xF0, 0xF0, 0xF0,
  0xF0, 0xF0, 0xF0, 0xF0, 0xF0, 0xF0, 0xF0, 0xF0, 0xF0, 0xF0,
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  0xF0, 0xF0, 0xF0, 0xF0, 0xF0, 0xF0, 0xF0, 0xF0
};

const uint8_t medalBitmap[4][32 * 32 / 8] PROGMEM {
  { // medalBronze.png
    0xFF, 0xFF, 0xFF, 0xFF, 0xFF, 0x7F, 0x9F, 0xEF, 0xF7, 0x7B,
    0xBD, 0xDD, 0xDE, 0xEE, 0xEE, 0x2E, 0xCE, 0xEE, 0xEE, 0x5D,
    0xBD, 0x7B, 0xF7, 0xEF, 0x9F, 0x7F, 0xFF, 0xFF, 0xFF, 0xFF,
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    0xFF, 0xF8, 0xFA, 0xFA, 0xFF, 0xFF, 0xFF, 0xFF
  },
  { // medalSilver.png
    0xFF, 0xFF, 0xFF, 0xFF, 0xFF, 0x7F, 0x9F, 0xEF, 0xF7, 0x7B,
    0xBD, 0xDD, 0xDE, 0xEE, 0xEE, 0x2E, 0xCE, 0xEE, 0xEE, 0x5D,
    0xBD, 0x7B, 0xF7, 0xEF, 0x9F, 0x7F, 0xFF, 0xFF, 0xFF, 0xFF,
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    0xFE, 0xF9, 0xFF, 0xFF, 0xFF, 0xFF, 0xFF, 0xFF
  },
  { // medalGold.png
    0xFF, 0xFF, 0xFF, 0xFF, 0xFF, 0x7F, 0x9F, 0xEF, 0xF7, 0x7B,
    0xBD, 0xDD, 0xDE, 0xEE, 0xEE, 0x2E, 0xCE, 0xEE, 0xEE, 0x5D,
    0xBD, 0x7B, 0xF7, 0xEF, 0x9F, 0x7F, 0xFF, 0xFF, 0xFF, 0xFF,
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    0xFF, 0xFF, 0xFF, 0xFF, 0xFF, 0xFF, 0xFF, 0xFF
  },
  { // medalPlatinum.png
    0xFF, 0xFF, 0xFF, 0xFF, 0xFF, 0x7F, 0x9F, 0xEF, 0xF7, 0x7B,
    0xBD, 0xDD, 0xDE, 0xEE, 0xEE, 0x2E, 0xCE, 0xEE, 0xEE, 0x5D,
    0xBD, 0x7B, 0xF7, 0xEF, 0x9F, 0x7F, 0xFF, 0xFF, 0xFF, 0xFF,
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    0xFB, 0xF8, 0xFF, 0xF8, 0xFF, 0xFC, 0xFF, 0xF8
  }
};

const uint8_t pipeUpBitmap[] PROGMEM { // pipeUp.png
  0xFF, 0x00, 0xAA, 0xFF, 0xFF, 0xFF, 0xFF, 0xFE, 0x55, 0xAA,
  0x00, 0x00, 0x00, 0xFF, 0xFF, 0xFF, 0xFF, 0x00, 0xAA, 0xFF,
  0xFF, 0xFF, 0xFF, 0xFF, 0x55, 0xAA, 0x00, 0x00, 0x00, 0xFF,
  0xFF, 0xFF, 0xFF, 0x00, 0xAA, 0xFF, 0xFF, 0xFF, 0xFF, 0xFF,
  0x55, 0xAA, 0x00, 0x00, 0x00, 0xFF, 0xFF, 0xFF, 0x07, 0x20,
  0x72, 0x77, 0x77, 0x77, 0x27, 0x53, 0x25, 0x52, 0x20, 0x00,
  0x00, 0x07, 0xFF, 0xFF
};

const uint8_t pipeUpMaskBitmap[] PROGMEM { // pipeUpMask.png
  0xFF, 0x00, 0x00, 0x00, 0x00, 0x00, 0x00, 0x00, 0x00, 0x00,
  0x00, 0x00, 0x00, 0xFF, 0xFF, 0xFF, 0xFF, 0x00, 0x00, 0x00,
  0x00, 0x00, 0x00, 0x00, 0x00, 0x00, 0x00, 0x00, 0x00, 0xFF,
  0xFF, 0xFF, 0xFF, 0x00, 0x00, 0x00, 0x00, 0x00, 0x00, 0x00,
  0x00, 0x00, 0x00, 0x00, 0x00, 0xFF, 0xFF, 0xFF, 0x07, 0x00,
  0x00, 0x00, 0x00, 0x00, 0x00, 0x00, 0x00, 0x00, 0x00, 0x00,
  0x00, 0x07, 0xFF, 0xFF
};

const uint8_t pipeDownBitmap[] PROGMEM { // pipeDown.png
  0xE0, 0x04, 0x4E, 0xEE, 0xEE, 0xEE, 0xE4, 0xCA, 0xA4, 0x4A,
  0x04, 0x00, 0x00, 0xE0, 0xFF, 0xFF, 0xFF, 0x00, 0x55, 0xFF,
  0xFF, 0xFF, 0xFF, 0xFF, 0xAA, 0x55, 0x00, 0x00, 0x00, 0xFF,
  0xFF, 0xFF, 0xFF, 0x00, 0x55, 0xFF, 0xFF, 0xFF, 0xFF, 0xFF,
  0xAA, 0x55, 0x00, 0x00, 0x00, 0xFF, 0xFF, 0xFF, 0xFF, 0x00,
  0x55, 0xFF, 0xFF, 0xFF, 0xFF, 0x7F, 0xAA, 0x55, 0x00, 0x00,
  0x00, 0xFF, 0xFF, 0xFF
};

const uint8_t pipeDownMaskBitmap[] PROGMEM { // pipeDownMask.png
  0xE0, 0x00, 0x00, 0x00, 0x00, 0x00, 0x00, 0x00, 0x00, 0x00,
  0x00, 0x00, 0x00, 0xE0, 0xFF, 0xFF, 0xFF, 0x00, 0x00, 0x00,
  0x00, 0x00, 0x00, 0x00, 0x00, 0x00, 0x00, 0x00, 0x00, 0xFF,
  0xFF, 0xFF, 0xFF, 0x00, 0x00, 0x00, 0x00, 0x00, 0x00, 0x00,
  0x00, 0x00, 0x00, 0x00, 0x00, 0xFF, 0xFF, 0xFF, 0xFF, 0x00,
  0x00, 0x00, 0x00, 0x00, 0x00, 0x00, 0x00, 0x00, 0x00, 0x00,
  0x00, 0xFF, 0xFF, 0xFF
};

const uint8_t newBitmap[] PROGMEM { // new.png
  0x80, 0xBE, 0x84, 0x88, 0xBE, 0x80, 0xBE, 0xAA, 0xAA, 0x80, 0x9E, 0xA0, 0x9C, 0xA0, 0x9E, 0x80
};

const uint8_t newMaskBitmap[] PROGMEM { // newMask.png
  0x80, 0x80, 0x80, 0x80, 0x80, 0x80, 0x80, 0x80, 0x80, 0x80, 0x80, 0x80, 0x80, 0x80, 0x80, 0x80
};

struct Point {
  float x;
  float y;
};

enum {
  SOUND_NONE,
  SOUND_DIE,
  SOUND_SCORE,
  SOUND_SCORE_NEXT,
};

enum {
  GAME_MODE_TITLE,
  GAME_MODE_GET_READY,
  GAME_MODE_PLAY,
  GAME_MODE_GAME_OVER
};

enum {
  MEDAL_BRONZE,
  MEDAL_SILVER,
  MEDAL_GOLD,
  MEDAL_PLATINUM
};

// button
ESPert_Button button[2];
static const int maxButtonDelay = 10; // milliseconds
float buttonDelay = 0.0f;
bool isButtonPressed[2] = {false};
int pressedButton = 0;
bool isButtonAllowed = true;

// game time
unsigned long lastFrameTime = 0l;
float elapsedTime = 0.0f;
unsigned long frameCount = 0l;
unsigned long frameRate = 0l;
unsigned long fpsLastFrameTime = 0l;
bool isFPSVisibled = false;
const uint8_t* fpsDigitImage[2] = {NULL};
const uint8_t* fpsDigitMaskImage[2] = {NULL};
bool isFPSDigitVisibled[2] = {false};
Point fpsDigitPosition[2] = {{116, 1}, {121, 1}};

// game
Point screenSize = {128, 64};
int gameMode = GAME_MODE_TITLE;
float gameOverVelocity = 0.0f;
Point gameOverPosition = {0.0f};
bool isGameOver = false;
int nextSound = SOUND_NONE;
float nextSoundDelay = 0.0f;
bool isCheckHighScore = false;

// bird
Point birdSize = {16, 16};
static const float birdAnimationSpeed = 8.0f / 1000.0f;
float birdFrame = 0.0f;
float birdDegrees = 0.0f;
int birdFiestFrame = 1; // change this value to 0 to enable birdFrame 0
int birdFrameDirection = 1;
bool isDropping = false;
float heightRatio = 0.0f;
static const float gravity = 9.8f;
float velocity = 0.0f;
static const float  initialVelocity = -2.5f;
Point birdPosition = {21, (screenSize.y - birdSize.y) * 0.5f};
float dropPosition = 0.0f;
bool isHit = false;
Point birdCollisionOffset = {2.0f, 2.0f};

// land
Point landSize = {128, 4};
static const float landSpeed = 25.0f / 1000.0f;
Point landOffset = {0.0f, screenSize.y - landSize.y};
static const float landPosition = screenSize.y - birdSize.y - landSize.y;

// score
String eepromKey = "FlappyBird";
int eepromAddress = 512 - eepromKey.length() - 3;
int highScore = 0;
int score = 0;
bool isNewHighScore = false;
Point scorePosition[3] = {{0, 1}, {0, 1}, {0, 1}};
const uint8_t* scoreDigitImage[3] = {NULL};
const uint8_t* scoreDigitMaskImage[3] = {NULL};

// score panel
static const float maxScorePanelOffset = 64.0f;
float scorePanelOffset = 0.0f;
float scorePanelScore = 0.0f;
float scorePanelHighScore = 0.0f;
const uint8_t* scorePanelHighScoreDigitImage[3] = {NULL};
const uint8_t* scorePanelScoreDigitImage[3] = {NULL};
const uint8_t* scorePanelMedalImage = NULL;

// pipe
Point pipeSize = {14, 32};
int pipeMinLength = 4;
static const int heightBetweenPipes = 30;
static const int numberOfPipes = 3;
static const int pipeRandomFrom = pipeMinLength - 1;
static const int pipeRandomTo = screenSize.y - landSize.y - pipeMinLength - 1 - heightBetweenPipes;
Point pipePosition[numberOfPipes] = {0.0f};
bool isPipeVisibled[numberOfPipes] = {false};
bool isPipeEnabled[numberOfPipes] = {false};
static const float pipeRandomFirstTime = 3000.0f; // milliseconds
static const float pipeRandomNextTime = 2000.0f; // milliseconds
float pipeRandomTime = 0.0f;

// function prototypes
void update();
void render();
void pressButtons();
void checkButtons();
void checkHighScore();
void readHighScores();
void writeHighScores();
String intToString(int value, int length, String prefixChar = "0");
void playSound(int index);
void initGame();
void resetGame();
void setFPSImages(int value);
void changeGameMode(int mode);
void drawBitmap(int x, int y, int width, int height, const uint8_t* bitmap, const uint8_t* mask = NULL, int color = ESPERT_BLACK);
void updateBirdAnimation(bool rotate);
float lerp(float t, float v0, float v1);
void setScorePanelImages(const uint8_t* digitImage[3], int value);
bool isHitPipe();

void setup() {
  espert.init();
  espert.oled.init();
  espert.buzzer.init(buzzerPin);
  randomSeed(analogRead(0));

  for (int i = 0; i < 2; i++) {
    if (isGamepadEnabled) {
      buttonPin[i] = gamepadPin[i];
    }

    button[i].init(buttonPin[i]);
  }

  initGame();
  espert.buzzer.on(1);
  espert.buzzer.on(0);
}

void loop() {
  update();
  render();
}

void update() {
  // game time
  unsigned long frameTime = millis();
  elapsedTime = frameTime - lastFrameTime;
  lastFrameTime = frameTime;

  // frame rate
  frameCount++;
  if (frameTime - fpsLastFrameTime >= 1000l) {
    frameRate = frameCount;
    frameCount = 0l;
    fpsLastFrameTime = frameTime;
    setFPSImages(frameRate);
  }

  // button
  buttonDelay += elapsedTime;
  if (buttonDelay >= maxButtonDelay) {
    buttonDelay = 0.0f;
    pressButtons();
  }
  checkButtons();

  // sound
  if (buzzerDuration > 0.0f) {
    buzzerDuration -= elapsedTime;

    if (buzzerDuration <= 0.0f) {
      buzzerDuration = 0.0f;
      espert.buzzer.off();
    }
  } else if (nextSoundDelay > 0.0f) {
    nextSoundDelay -= elapsedTime;

    if (nextSoundDelay <= 0.0f) {
      nextSoundDelay = 0.0f;
      playSound(nextSound);
    }
  }

  switch (gameMode) {
    case GAME_MODE_TITLE:
    case GAME_MODE_GET_READY:
      updateBirdAnimation(false);

      if (birdPosition.y >= 20 + (gameMode == GAME_MODE_TITLE ? 5 : 0)) {
        velocity = initialVelocity * 0.7f;
      }
      break;

    case GAME_MODE_PLAY:
      updateBirdAnimation(true);

      if (isGameOver) {
        changeGameMode(GAME_MODE_GAME_OVER);
      } else if (!isHit) {
        for (int i = 0; i < numberOfPipes; i++) {
          if (isPipeVisibled[i]) {
            if (isPipeEnabled[i] && birdPosition.x + (birdSize.x * 0.5f) >= pipePosition[i].x + (pipeSize.x * 0.5f)) {
              if (birdPosition.y >= pipePosition[i].y - birdCollisionOffset.y && pipePosition[i].y <= pipePosition[i].y + heightBetweenPipes - birdSize.y + birdCollisionOffset.y) { // between two pipes
                addScore(1);
                isPipeEnabled[i] = false;
                playSound(SOUND_SCORE);
              }
            }

            pipePosition[i].x -= elapsedTime * landSpeed;
            if (pipePosition[i].x < -pipeSize.x) {
              isPipeVisibled[i] = false;
            }
          }
        }

        if (pipeRandomTime == 0.0f) {
          for (int i = 0; i < numberOfPipes; i++) {
            if (!isPipeVisibled[i]) {
              isPipeVisibled[i] = true;
              isPipeEnabled[i] = true;
              pipePosition[i].x = landOffset.x + (screenSize.x - landOffset.x);
              pipePosition[i].y = random(pipeRandomFrom, pipeRandomTo);
              pipeRandomTime = pipeRandomNextTime;
              break;
            }
          }
        } else {
          pipeRandomTime -= elapsedTime;

          if (pipeRandomTime <= 0.0f) {
            pipeRandomTime = 0.0f;
          }
        }
      }
      break;

    case GAME_MODE_GAME_OVER:
      gameOverVelocity += gravity * (elapsedTime / 2000.0f);
      gameOverPosition.y = constrain(gameOverPosition.y + gameOverVelocity, -64, landPosition);

      if (gameOverVelocity > 0.0f && gameOverPosition.y >= 0.0f) {
        gameOverPosition.y = 0.0f;

        if (isCheckHighScore && scorePanelOffset != maxScorePanelOffset) {
          isCheckHighScore = false;
          checkHighScore();
        }

        scorePanelOffset = lerp(0.2f, scorePanelOffset, 0.0f);

        if (scorePanelOffset <= 0.1f) {
          if (!isButtonAllowed) {
            isButtonAllowed = true;
            pressedButton = 0;
          }

          if (scorePanelScore != score) {
            float speed = constrain(fabs(scorePanelScore - score), 5.0f, 999.0f);
            speed *= elapsedTime / 1000.0f;

            if (scorePanelScore < score)
            {
              scorePanelScore += speed;

              if (scorePanelScore > score)
              {
                scorePanelScore = score;
              }
            }
            else if (scorePanelScore > score)
            {
              scorePanelScore -= speed;

              if (scorePanelScore < score)
              {
                scorePanelScore = score;
              }
            }

            setScorePanelImages(scorePanelScoreDigitImage, scorePanelScore);

            if (isNewHighScore && scorePanelScore > scorePanelHighScore) {
              scorePanelHighScore = scorePanelScore;
              setScorePanelImages(scorePanelHighScoreDigitImage, scorePanelHighScore);
            }
          }
        }
      }
      break;
  }

  ESP.wdtFeed();
}

void render() {
  espert.oled.clear(false);
  drawBitmap(0, 0, screenSize.x, screenSize.y, backgroundBitmap, NULL, ESPERT_WHITE);

  switch (gameMode) {
    case GAME_MODE_TITLE:
      drawBitmap(32, 1, 64, 16, titleBitmap, titleMaskBitmap);
      drawBitmap(40, 48, 64, 16, makerAsiaBitmap, makerAsiaMaskBitmap);
      drawBitmap(birdPosition.x, birdPosition.y, 16, 16, birdBitmap[(int)birdFrame][(int)birdDegrees], birdMaskBitmap[(int)birdFrame][(int)birdDegrees]);
      break;

    case GAME_MODE_GET_READY:
      drawBitmap(32, 1, 64, 56, getReadyBitmap, getReadyMaskBitmap);
      drawBitmap(birdPosition.x, birdPosition.y, 16, 16, birdBitmap[(int)birdFrame][(int)birdDegrees], birdMaskBitmap[(int)birdFrame][(int)birdDegrees]);
      break;

    case GAME_MODE_PLAY:
    case GAME_MODE_GAME_OVER:
      for (int i = 0; i < numberOfPipes; i++) {
        if (isPipeVisibled[i]) {
          drawBitmap(pipePosition[i].x, pipePosition[i].y - pipeSize.y, 16, 32, pipeUpBitmap, pipeUpMaskBitmap);
          drawBitmap(pipePosition[i].x, pipePosition[i].y + heightBetweenPipes, 16, 32, pipeDownBitmap, pipeDownMaskBitmap);
        }
      }

      drawBitmap(birdPosition.x, birdPosition.y, 16, 16, birdBitmap[(int)birdFrame][(int)birdDegrees], birdMaskBitmap[(int)birdFrame][(int)birdDegrees]);

      if (gameMode == GAME_MODE_PLAY) {
        for (int i = 0; i < 3; i++) {
          if (scoreDigitImage[i]) {
            drawBitmap(scorePosition[i].x, scorePosition[i].y, 8, 16, scoreDigitImage[i], scoreDigitMaskImage[i]);
          }
        }
      } else if (gameMode == GAME_MODE_GAME_OVER) {
        drawBitmap(gameOverPosition.x, gameOverPosition.y, 64, 16, gameOverBitmap, gameOverMaskBitmap);
        drawBitmap(25, 16 + scorePanelOffset, 80, 40, scorePanelBitmap, scorePanelMaskBitmap);

        if (scorePanelMedalImage && scorePanelScore == score) {
          drawBitmap(28, 24 + scorePanelOffset, 32, 32, scorePanelMedalImage);
        }

        if (isNewHighScore && scorePanelScore == scorePanelHighScore) {
          drawBitmap(63, 36 + scorePanelOffset, 16, 8, newBitmap);
        }

        for (int i = 0; i < 3; i++) {
          int x = 78 + (i * 7);
          if (scorePanelScoreDigitImage[i]) {
            drawBitmap(x, 25 + scorePanelOffset, 8, 8, scorePanelScoreDigitImage[i]);
          }

          if (scorePanelHighScoreDigitImage[i]) {
            drawBitmap(x, 44 + scorePanelOffset, 8, 8, scorePanelHighScoreDigitImage[i]);
          }
        }
      }
      break;
  }

  drawBitmap((int)landOffset.x, landOffset.y, 128, 8, landBitmap, landMaskBitmap);
  drawBitmap((int)(landOffset.x - landSize.x), landOffset.y, 128, 8, landBitmap, landMaskBitmap);

  if (isFPSVisibled) {
    for (int i = 0; i < 2; i++) {
      drawBitmap(fpsDigitPosition[i].x, fpsDigitPosition[i].y, 8, 8, fpsDigitImage[i], fpsDigitMaskImage[i]);
    }
  }

  espert.oled.update();
  ESP.wdtFeed();
}

void setFPSImages(int value) {
  if (isFPSVisibled) {
    value = constrain(value, 0, 99);
    String fpsString = intToString(value, 2, "0");

    for (int i = 0; i < 2; i++) {
      int n = fpsString.charAt(i) - '0';
      fpsDigitImage[i] = numberBitmap[n];
      fpsDigitMaskImage[i] = numberMaskBitmap[n];
      isFPSDigitVisibled[i] = isFPSVisibled;
    }

    if (value > 0 && value < 10) {
      isFPSDigitVisibled[0] = false;
    }
  }
}

void pressButtons() {
  for (int i = 0; i < 2; i++) {
    bool isPressed = (digitalRead(buttonPin[i]) == LOW) ? true : false;

    if (isPressed != isButtonPressed[i]) {
      isButtonPressed[i] = isPressed;

      if (isButtonAllowed) {
        if (isPressed) {
          pressedButton = i + 1;

          if (gameMode == GAME_MODE_GET_READY || gameMode == GAME_MODE_PLAY) {
            velocity = initialVelocity;
            isDropping = false;

            if (gameMode == GAME_MODE_GET_READY) {
              changeGameMode(GAME_MODE_PLAY);
            }
          }
        } else if (pressedButton == i + 1) {
          pressedButton = 0;

          if (gameMode == GAME_MODE_TITLE) {
            changeGameMode(GAME_MODE_GET_READY);
          } else if (gameMode == GAME_MODE_GAME_OVER) {
            changeGameMode(GAME_MODE_TITLE);
          }
        }
      }
      break;
    }
  }
}

String intToString(int value, int length, String prefixChar) {
  String stringValue = String(value);
  String prefix = "";

  for (int i = 0; i < length - stringValue.length(); i++) {
    prefix += prefixChar;
  }

  return prefix + stringValue;
}

void readHighScores() {
  int i = eepromAddress;

  if (espert.eeprom.read(i, eepromKey.length()) == eepromKey) {
    i += eepromKey.length();
    String data = espert.eeprom.read(i, 3);
    highScore = data.toInt();

    if (highScore < 0 || highScore > 999) {
      highScore = constrain(highScore, 0, 999);
      writeHighScores();
    }
  }
}

void writeHighScores() {
  int i = eepromAddress;
  espert.eeprom.write(i, eepromKey);

  i += eepromKey.length();
  espert.eeprom.write(i, intToString(highScore, 3, "0"));
}

void playSound(int index) {
  if (isSoundEnabled) {
    nextSound = SOUND_NONE;
    nextSoundDelay = 0.0f;
    int frequency = 0;

    switch (index) {
      case SOUND_SCORE:
        frequency = 5;
        buzzerDuration = 20.0f;
        nextSound = SOUND_SCORE_NEXT;
        nextSoundDelay = 20.0f;
        break;

      case SOUND_SCORE_NEXT:
        frequency = 10;
        buzzerDuration = 80.0f;
        break;

      case SOUND_DIE:
        frequency = 10;
        buzzerDuration = 1000.0f;
        break;

      default:
        frequency = 0;
        buzzerDuration = 0.0f;
        break;
    }

    espert.buzzer.on(frequency);
  }
}

void setScoreImages() {
  memset(&scoreDigitImage, NULL, sizeof(scoreDigitImage));
  memset(&scoreDigitMaskImage, NULL, sizeof(scoreDigitMaskImage));

  String string = intToString(score, 3, "0");
  int width = 6;
  int startDigit = 2;

  if (string.charAt(0) != '0') {
    width += 12;
    startDigit = 0;
  } else if (string.charAt(1) != '0') {
    width += 6;
    startDigit = 1;
  }

  int x = (screenSize.x - width) * 0.5f;

  for (int i = startDigit; i < 3; i++) {
    int n = string.charAt(i) - '0';
    scoreDigitImage[i] = numberScoreBitmap[n];
    scoreDigitMaskImage[i] = numberScoreMaskBitmap[n];
    scorePosition[i].x = x;
    x += 6;
  }
}

void setHighScoreImages() {
  String string = intToString(highScore, 3, "0");

  for (int i = 0; i < 3; i++) {
    scorePanelHighScoreDigitImage[i] = numberBitmap[string.charAt(i) - '0'];
  }
}

void setScorePanelImages(const uint8_t* digitImage[3], int value) {
  String string = intToString(value, 3, "0");
  bool found = false;

  for (int i = 0; i < 3; i++) {
    digitImage[i] = NULL;
    int n = string.charAt(i) - '0';

    if (found || (!found && n > 0) || i == 2) {
      found = true;
      digitImage[i] = numberBitmap[n];
    }
  }
}

void checkButtons() {
  if (isButtonAllowed) {
    switch (gameMode) {
      case GAME_MODE_TITLE:
        break;

      case GAME_MODE_PLAY:
        if (pressedButton == 1) {
        } else if (pressedButton == 2) {
        }
        break;
    }
  }
}

void changeGameMode(int mode) {
  switch (mode) {
    case GAME_MODE_TITLE:
      resetGame();
      birdPosition.x = (screenSize.x - birdSize.x) * 0.5f;
      birdDegrees = 1;
      break;

    case GAME_MODE_GET_READY:
      resetBird();
      birdDegrees = 1;
      break;

    case GAME_MODE_PLAY:
      break;

    case GAME_MODE_GAME_OVER:
      isCheckHighScore = true;
      gameOverVelocity = initialVelocity * 0.7f;
      gameOverPosition.x = 32;
      gameOverPosition.y = 0;
      scorePanelOffset = maxScorePanelOffset;
      scorePanelScore = 0;
      scorePanelHighScore = highScore; // old highscore
      scorePanelMedalImage = NULL;
      setScorePanelImages(scorePanelScoreDigitImage, scorePanelScore);
      setScorePanelImages(scorePanelHighScoreDigitImage, scorePanelHighScore);
      isButtonAllowed = false;
      pressedButton = 0;
      break;
  }

  gameMode = mode;
}

void checkHighScore() {
  isNewHighScore = false;

  if (score >= 40) {
    scorePanelMedalImage = medalBitmap[MEDAL_PLATINUM];
  } else if (score >= 30) {
    scorePanelMedalImage = medalBitmap[MEDAL_GOLD];
  } else if (score >= 20) {
    scorePanelMedalImage = medalBitmap[MEDAL_SILVER];
  } else if (score >= 10) {
    scorePanelMedalImage = medalBitmap[MEDAL_BRONZE];
  }

  if (score > highScore) {
    isNewHighScore = true;
    highScore = score;
    writeHighScores();
  }
}

void addScore(int value) {
  score = constrain(score + value, 0, 999);
  setScoreImages();
}

void initGame() {
  readHighScores();
  resetGame();
  changeGameMode(GAME_MODE_TITLE);
  lastFrameTime = millis();
  fpsLastFrameTime = lastFrameTime;
  setFPSImages(frameRate);
}

void resetBird() {
  velocity = 0.0f;
  birdFrameDirection = 1;
  birdDegrees = 0.0f;
  isDropping = false;
  dropPosition = 0.0f;
  heightRatio = 0.0f;
  birdPosition.x = 21;
  birdPosition.y = (screenSize.y - birdSize.y) * 0.5f;
  isHit = false;
  isGameOver = false;
}

void resetGame() {
  resetBird();
  isCheckHighScore = false;
  score = 0;
  setScoreImages();
  buttonDelay = 0.0f;
  pressedButton = 0;
  landOffset.x = screenSize.x;

  memset(pipePosition, 0, sizeof(pipePosition));
  memset(isPipeVisibled, false, sizeof(isPipeVisibled));
  memset(isPipeEnabled, false, sizeof(isPipeEnabled));

  pipeRandomTime = pipeRandomFirstTime;
  gameOverVelocity = 0.0f;
  gameOverPosition.x = 32;
  gameOverPosition.y = 0;
  scorePanelOffset = 0.0f;
  scorePanelScore = 0.0f;
  scorePanelHighScore = 0.0f;
  isNewHighScore = false;
  memset(scorePanelHighScoreDigitImage, NULL, sizeof(scorePanelHighScoreDigitImage));
  memset(scorePanelScoreDigitImage, NULL, sizeof(scorePanelScoreDigitImage));
  scorePanelMedalImage = NULL;
  isButtonAllowed = true;
}

void updateBirdAnimation(bool rotate) {
  isHit = isHitPipe();

  if (!isGameOver) {
    float speed = elapsedTime * birdAnimationSpeed;
    birdFrame += speed * birdFrameDirection;

    if (birdFrameDirection > 0 && birdFrame >= numberOfFrames) {
      birdFrame = numberOfFrames - 1;
      birdFrameDirection *= -1;
    } else if ( birdFrameDirection < 0 && birdFrame <= 0.0f) {
      birdFrame = 0.0f;
      birdFrameDirection *= -1;
    }

    velocity += gravity * (elapsedTime / 2000.0f);
    birdPosition.y = constrain(birdPosition.y + velocity, 0, landPosition);

    if (birdPosition.y == 0.0f) {
      velocity = 0.0f;
    }

    if (rotate) {
      if (velocity >= 0.0f) {
        if (!isDropping) {
          isDropping = true;
          dropPosition = birdPosition.y;
          heightRatio = (numberOfDegrees - birdFiestFrame) / (landPosition - (birdSize.y * 0.25f) - birdPosition.y);
        }

        birdDegrees = birdFiestFrame + ((birdPosition.y - dropPosition) * heightRatio);
      } else {
        birdDegrees -= speed * 2.0f;
      }

      birdDegrees = constrain(birdDegrees, birdFiestFrame, numberOfDegrees - 1);
    }

    if (birdDegrees == numberOfDegrees - 1) {
      birdFrame = 1.0f;

      if (!isGameOver && birdPosition.y == landPosition) {
        if (!isHit) {
          isHit = true;
          playSound(SOUND_DIE);
        }

        isGameOver = true;
        isButtonAllowed = false;
      }
    }

    if (!isHit) {
      speed = elapsedTime * landSpeed;
      landOffset.x -= speed;

      if (landOffset.x <= 0.0f) {
        landOffset.x = screenSize.x + landOffset.x;
      }
    }
  }
}

void drawBitmap(int x, int y, int width, int height, const uint8_t* bitmap, const uint8_t* mask, int color) {
  if (mask) {
    espert.oled.setColor(1 - color);
    espert.oled.drawBitmap(x, y, width, height, mask, false);
  }

  espert.oled.setColor(color);
  espert.oled.drawBitmap(x, y, width, height, bitmap, false);
}

float lerp(float t, float v0, float v1) {
  v0 = (1.0f - t) * v0 + t * v1;

  if (fabs(v1 - v0) < 1.0f)
  {
    v0 = v1;
  }

  return v0;
}

bool isHitPipe() {
  if (!isHit) {
    float x1 = birdPosition.x + birdCollisionOffset.x;
    float y1 = birdPosition.y + birdCollisionOffset.y;
    float w1 = birdSize.x - (birdCollisionOffset.x * 2.0f);
    float h1 = birdSize.y - (birdCollisionOffset.y * 2.0f);
    float w2 = pipeSize.x;
    float h2 = pipeSize.y;

    for (int i = 0; i < numberOfPipes && !isHit; i++) {
      if (isPipeVisibled[i]) {
        float x2 = pipePosition[i].x;

        for (int pipe = 0; pipe < 2 && !isHit; pipe++) {
          float y2 = pipePosition[i].y + (pipe == 0 ? -pipeSize.y : heightBetweenPipes);

          isHit = !(x1 > x2 + w2 || x1 + w1 < x2 || y1 > y2 + h2 || y1 + h1 < y2);

          if (isHit) {
            playSound(SOUND_DIE);
            isButtonAllowed = false;
          }
        }
      }
    }
  }

  return isHit;
}
